## sdkconfig.defaults
```kconfig
# ESP32-TUX Common Configuration
# Target-specific settings are in sdkconfig.defaults.esp32 and sdkconfig.defaults.esp32s3
#
# Common compiler and optimization settings
CONFIG_COMPILER_OPTIMIZATION_SIZE=y
CONFIG_PERIPH_CTRL_FUNC_IN_IRAM=y

# Timezone (can be overridden via menuconfig)
CONFIG_TIMEZONE_STRING="WET0WEST,M3.5.0/1,M10.5.0/2"

# TLS settings for Bambu printer connections (self-signed certs)
CONFIG_ESP_TLS_INSECURE=y
CONFIG_ESP_TLS_SKIP_SERVER_CERT_VERIFY=y

# FAT filesystem for SD card
CONFIG_FATFS_LFN_HEAP=y

# Enable certificate bundle for OTA from GitHub (adds ~60KB to flash)
CONFIG_MBEDTLS_CERTIFICATE_BUNDLE=y
CONFIG_MBEDTLS_CERTIFICATE_BUNDLE_DEFAULT_FULL=y

# LVGL configuration - use custom lv_conf.h
# CONFIG_LV_CONF_SKIP is not set

# LVGL extras required by the application
CONFIG_LV_USE_MSG=y
CONFIG_LV_USE_MSGBOX=y
```

## sdkconfig.defaults.esp32
```kconfig
# =============================================================================
# WT32-SC01 (ESP32) Device Configuration
# =============================================================================

# Device selection - disable all others, enable WT32-SC01
CONFIG_TUX_DEVICE_WT32_SC01=y
CONFIG_TUX_DEVICE_WT32_SC01_PLUS=n
CONFIG_TUX_DEVICE_MAKERFABS35=n
CONFIG_TUX_DEVICE_MAKERFABS35_S3=n
CONFIG_TUX_DEVICE_MAKERFABS43_S3=n

# Flash size: 4MB
CONFIG_ESPTOOLPY_FLASHSIZE_4MB=y

# Use custom 4MB partition table with SPIFFS storage
CONFIG_PARTITION_TABLE_CUSTOM=y
CONFIG_PARTITION_TABLE_CUSTOM_FILENAME="partitions/partition-4MB.csv"

# =============================================================================
# SPIRAM Configuration
# =============================================================================
CONFIG_SPIRAM=y
CONFIG_SPIRAM_TRY_ALLOCATE_WIFI_LWIP=y
CONFIG_SPIRAM_USE_MALLOC=y
CONFIG_SPIRAM_MALLOC_ALWAYSINTERNAL=4096
CONFIG_SPIRAM_MALLOC_RESERVE_INTERNAL=32768

# CPU frequency
CONFIG_ESP_DEFAULT_CPU_FREQ_MHZ_240=y

# Enable mDNS support in lwip
CONFIG_LWIP_DNS_SUPPORT_MDNS_QUERIES=y
CONFIG_LWIP_MDNS_RESPONDER=y

# Enable FAT long filenames (printer serials are 15+ chars)
CONFIG_FATFS_LFN_HEAP=y
CONFIG_FATFS_MAX_LFN=255

# =============================================================================
# mbedTLS Configuration for TLS/MQTT Connections
# =============================================================================
# Use PSRAM (external memory) for TLS buffers when available
CONFIG_MBEDTLS_EXTERNAL_MEM_ALLOC=y

# Asymmetric content length: large input buffer, smaller output buffer
CONFIG_MBEDTLS_ASYMMETRIC_CONTENT_LEN=y
CONFIG_MBEDTLS_SSL_IN_CONTENT_LEN=16384
CONFIG_MBEDTLS_SSL_OUT_CONTENT_LEN=2048

# Dynamic buffer allocation - frees memory during idle periods
CONFIG_MBEDTLS_DYNAMIC_BUFFER=y
CONFIG_MBEDTLS_DYNAMIC_FREE_CONFIG_DATA=y
CONFIG_MBEDTLS_DYNAMIC_FREE_CA_CERT=y

# Disable hardware AES to avoid internal RAM DMA exhaustion
CONFIG_MBEDTLS_HARDWARE_AES=n

# =============================================================================
# Common Settings
# =============================================================================
# Compiler optimization
CONFIG_COMPILER_OPTIMIZATION_SIZE=y
CONFIG_PERIPH_CTRL_FUNC_IN_IRAM=y

# Timezone
CONFIG_TIMEZONE_STRING="WET0WEST,M3.5.0/1,M10.5.0/2"

# TLS settings for Bambu printer connections (self-signed certs)
CONFIG_ESP_TLS_INSECURE=y
CONFIG_ESP_TLS_SKIP_SERVER_CERT_VERIFY=y

# Certificate bundle for OTA updates from GitHub (HTTPS)
CONFIG_MBEDTLS_CERTIFICATE_BUNDLE=y
CONFIG_MBEDTLS_CERTIFICATE_BUNDLE_DEFAULT_FULL=y

# =============================================================================
# LVGL Configuration
# =============================================================================
# Use custom lv_conf.h
# CONFIG_LV_CONF_SKIP is not set

# LVGL extras required by the application
CONFIG_LV_USE_MSG=y
CONFIG_LV_USE_MSGBOX=y
CONFIG_LV_USE_SNAPSHOT=y
CONFIG_LV_COLOR_DEPTH_16=y
CONFIG_LV_COLOR_DEPTH=16
CONFIG_LV_FONT_MONTSERRAT_14=y
```

## sdkconfig.defaults.esp32s3
```kconfig
# =============================================================================
# WT32-SC01-Plus (ESP32-S3) Device Configuration
# =============================================================================

# Device selection - disable all others, enable WT32-SC01-Plus
CONFIG_TUX_DEVICE_WT32_SC01=n
CONFIG_TUX_DEVICE_WT32_SC01_PLUS=y
CONFIG_TUX_DEVICE_MAKERFABS35=n
CONFIG_TUX_DEVICE_MAKERFABS35_S3=n
CONFIG_TUX_DEVICE_MAKERFABS43_S3=n

# Flash size: 8MB
CONFIG_ESPTOOLPY_FLASHSIZE_8MB=y

# Use custom 8MB partition table with SPIFFS storage and OTA
CONFIG_PARTITION_TABLE_CUSTOM=y
CONFIG_PARTITION_TABLE_CUSTOM_FILENAME="partitions/partition-8MB.csv"

# =============================================================================
# SPIRAM Configuration
# Uses QUAD mode at 40MHz (NOT OCT/80MHz - device doesn't boot with OCT)
# =============================================================================
CONFIG_SPIRAM=y
CONFIG_SPIRAM_MODE_QUAD=y
CONFIG_SPIRAM_SPEED_40M=y
CONFIG_SPIRAM_TYPE_AUTO=y
CONFIG_SPIRAM_ALLOW_STACK_EXTERNAL_MEMORY=y
CONFIG_SPIRAM_BOOT_INIT=y
CONFIG_SPIRAM_USE_MALLOC=y
CONFIG_SPIRAM_MEMTEST=y
CONFIG_SPIRAM_TRY_ALLOCATE_WIFI_LWIP=y
CONFIG_SPIRAM_MALLOC_ALWAYSINTERNAL=4096
# Reserve more internal RAM for DMA operations (default 32768, increase for multi-TLS)
CONFIG_SPIRAM_MALLOC_RESERVE_INTERNAL=65536

# PSRAM Clock and CS IO for ESP32S3
CONFIG_DEFAULT_PSRAM_CLK_IO=30
CONFIG_DEFAULT_PSRAM_CS_IO=26

# =============================================================================
# Clock Configuration
# Flash: 80MHz, SPIRAM: 40MHz, CPU: 240MHz
# =============================================================================
CONFIG_ESPTOOLPY_FLASHFREQ_80M=y
CONFIG_ESPTOOLPY_FLASHFREQ="80m"
CONFIG_SPIRAM_SPEED=40
CONFIG_ESP_DEFAULT_CPU_FREQ_MHZ_240=y
CONFIG_ESP_DEFAULT_CPU_FREQ_MHZ=240
CONFIG_ESP32S3_DEFAULT_CPU_FREQ_240=y
CONFIG_ESP32S3_DEFAULT_CPU_FREQ_MHZ=240

# Enable FAT long filenames for SD card (printer serials are 15+ chars)
CONFIG_FATFS_LFN_HEAP=y
CONFIG_FATFS_MAX_LFN=255

# =============================================================================
# mbedTLS Configuration for Multi-Printer TLS/MQTT Connections
# =============================================================================
# Use PSRAM (external memory) for TLS buffers
# Critical for multi-printer MQTT connections - each TLS session needs ~17KB
CONFIG_MBEDTLS_EXTERNAL_MEM_ALLOC=y

# Asymmetric content length: large input buffer, smaller output buffer
# Reduces memory usage while supporting large server certificates
CONFIG_MBEDTLS_ASYMMETRIC_CONTENT_LEN=y
CONFIG_MBEDTLS_SSL_IN_CONTENT_LEN=16384
CONFIG_MBEDTLS_SSL_OUT_CONTENT_LEN=2048

# Dynamic buffer allocation - allocates TLS buffers only when needed
# Frees memory during idle periods between TLS operations
CONFIG_MBEDTLS_DYNAMIC_BUFFER=y
CONFIG_MBEDTLS_DYNAMIC_FREE_CONFIG_DATA=y
CONFIG_MBEDTLS_DYNAMIC_FREE_CA_CERT=y

# Disable hardware AES - uses internal RAM for DMA which can exhaust with multiple TLS connections
# Software AES is slightly slower but allocates from PSRAM (via MBEDTLS_EXTERNAL_MEM_ALLOC)
# See: https://github.com/espressif/esp-idf/issues/9935
CONFIG_MBEDTLS_HARDWARE_AES=n

# Enable hardware acceleration for SHA and MPI (these don't conflict with PSRAM)
CONFIG_MBEDTLS_HARDWARE_MPI=y
CONFIG_MBEDTLS_MPI_USE_INTERRUPT=y
CONFIG_MBEDTLS_HARDWARE_SHA=y

# =============================================================================
# Common Settings
# =============================================================================
# Compiler optimization
CONFIG_COMPILER_OPTIMIZATION_SIZE=y
CONFIG_PERIPH_CTRL_FUNC_IN_IRAM=y

# Timezone
CONFIG_TIMEZONE_STRING="WET0WEST,M3.5.0/1,M10.5.0/2"

# TLS settings for Bambu printer connections (self-signed certs)
CONFIG_ESP_TLS_INSECURE=y
CONFIG_ESP_TLS_SKIP_SERVER_CERT_VERIFY=y

# Certificate bundle for OTA updates from GitHub (HTTPS)
CONFIG_MBEDTLS_CERTIFICATE_BUNDLE=y
CONFIG_MBEDTLS_CERTIFICATE_BUNDLE_DEFAULT_FULL=y

# =============================================================================
# LVGL Configuration
# =============================================================================
# Use custom lv_conf.h
# CONFIG_LV_CONF_SKIP is not set

# LVGL extras required by the application
CONFIG_LV_USE_MSG=y
CONFIG_LV_USE_MSGBOX=y
CONFIG_LV_USE_SNAPSHOT=y
CONFIG_LV_COLOR_DEPTH_16=y
CONFIG_LV_COLOR_DEPTH=16
CONFIG_LV_FONT_MONTSERRAT_14=y
```
